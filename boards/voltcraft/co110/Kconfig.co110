## boards/voltcraft/co110/Kconfig.co110
```kconfig
# SPDX-License-Identifier: Apache-2.0
config BOARD_CO110
	select SOC_STM32L431XX
```

## boards/voltcraft/co110/board.yml
```yaml
board:
  name: co110
  full_name: Voltcraft CO-110 CO2 monitor
  vendor: zephyr
  socs:
    - name: stm32l431xx
```
